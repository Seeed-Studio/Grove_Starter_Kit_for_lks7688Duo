#include <Wire.h>
#include <SeeedOLED.h>
#include "TimerOne.h"
#include <Process.h>
#include <IRSendRev.h>
#include <avr/pgmspace.h>

#define BIT_LEN         0
#define BIT_START_H     1
#define BIT_START_L     2
#define BIT_DATA_H      3
#define BIT_DATA_L      4
#define BIT_DATA_LEN    5
#define BIT_DATA        6

#define ON   1
#define OFF  0

const unsigned char lamp [] PROGMEM = {
0x00, 0x00, 0x00, 0x00, 0x00, 0x00, 0x00, 0x00, 0x00, 0x00, 0x00, 0x00, 0x00, 0x00, 0x00, 0x00,
0x00, 0x00, 0x00, 0x00, 0x00, 0x00, 0x7C, 0xF0, 0x00, 0x00, 0x00, 0x00, 0x00, 0x00, 0x00, 0x00,
0x00, 0x00, 0x00, 0x00, 0x00, 0xC0, 0x70, 0x00, 0x00, 0x00, 0x00, 0x00, 0x00, 0x00, 0x00, 0x00,
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0x00, 0x00, 0x00, 0x00, 0x00, 0x00, 0x00, 0x00, 0x00, 0x00, 0x00, 0x00, 0x00, 0x00, 0x00, 0x00
};

// Change this array in your situation,the element number may be different.
unsigned char IR_code[6] = {128, 127, 192, 63, 192, 63};  // global variable

int relayStatus = OFF;      // global variable
int touchSensor_port = 7;   // I/O
int relay_port = 4;         // I/O
int lightSensor_port = A0;  // I/O
int IR_Rvieve_port = 6;     // I/O

/**
 * @Function - relayHandle
 * Info - Turn on or turn off relay
 */
void relayHandle(int status){
  digitalWrite(relay_port, status);
  status ? relayStatus = ON : relayStatus = OFF;  
}

/**
 *  @Function - relayReverse
 *  Info - if relay is on then turn it off, if it's off then turn it on  
 */
void relayReverse()
{  
  relayHandle(!relayStatus);        
}

/**
 * @Function - readTouchSensorStatus
 * Info - Read and return value of Grove - Touch Sensor
 */
int readTouchSensorStatus(void){
  return digitalRead(touchSensor_port);  
}

/**
 * @Function - hardWare_init
 * Info - Initialize I/O configuration
 */
void hardWare_init()
{
  pinMode(touchSensor_port, INPUT);  
  pinMode(relay_port, OUTPUT);
  pinMode(lightSensor_port, INPUT);
  digitalWrite(relay_port, HIGH);
    
  SeeedOled.init();  //initialze SEEED OLED display
  DDRB|=0x21;        
  PORTB |= 0x21;
  SeeedOled.clearDisplay();               // clear the screen and set start position to top left corner
  SeeedOled.drawBitmap(lamp,1024);
  SeeedOled.setNormalDisplay(); 
  SeeedOled.setTextXY(1,9); 
  SeeedOled.putString("lks7688");
  
  IR.Init(IR_Rvieve_port);
}

/**
 * @Function - ir_Revieve
 * Info - Decode ir data revieved and control relay
 */
void ir_Revieve()
{   
  unsigned char dta[20];
  if(IR.IsDta())                  // get IR data
  {
    IR.Recv(dta);               // receive data to dta   
    boolean markStatus = true;
    for(int i=0; i<dta[BIT_DATA_LEN]; i++)
    {
        if(IR_code[i] != dta[i+BIT_DATA])
        {
            markStatus = false;
        }
    }
    if(markStatus) relayReverse();
  } 
}

/**
 * @Function - display_oled
 * Info - OLED display, show a value
 */
void display_oled(int value)
{ 
  SeeedOled.setTextXY(3,10); 
  SeeedOled.putString("Bright");
  SeeedOled.setTextXY(5,11);
  SeeedOled.putString("    ");
  SeeedOled.setTextXY(5,11);
  SeeedOled.putNumber(value);       
}

/**
 * @Function - MCS_UploadData
 * Info - Upload data to Mediatek Cloud Sandbox
 *        Recall yun-bridge method Process
 */
void MCS_UploadData(int data)
{    
  Process p;
  p.begin("ash");
  p.addParameter("/root/mcs_upload_data.sh");
  p.addParameter(String(data));
  p.run();
}

/**
 * @Fcuntion - MCS_RecieveData
 * Info - Recal yun-bridge Process method, get a number from file "mcs_data" in linux system.
 */
String MCS_RecieveData(void)
{
  String data = "";
  Process p;
  
  p.begin("cat");
  p.addParameter("/tmp/mcs_data");
  p.run();

  int index = 0;
  while (p.available() > 0) {
    char c = p.read();
    data += (String)c;      
  }
  return data;
}

/**
 * @Function - touchSensorHandler
 * Info - Handle Grove - Touch Sensor to control relay.
 */
void touchSensorHandler()
{  
  if(digitalRead(touchSensor_port) == HIGH)
  {
    while(readTouchSensorStatus() == HIGH);
    relayReverse();
    Serial.println("TouchSensor handle");     
  }
}

/**
 * @Function - isr_handle
 * Info - ISR handle method
 */
void isr_handle()
{
   touchSensorHandler();   
   ir_Revieve(); 
}

void setup() {
  Bridge.begin();  
  Wire.begin();  
  hardWare_init();
  
  Serial.begin(9600);
  //while(!Serial);
  Serial.println("Begin...");
  
  Timer1.initialize(200000);         // initialize timer1, and set a 1/2 second period
  Timer1.attachInterrupt(isr_handle);  // attaches callback() as a timer overflow interrupt
    
}

void loop() {
  //Get light sensor value
  int light_value = analogRead(lightSensor_port);  

  //Display light sensor value to OLED
  display_oled(light_value);
  
  //Revieve switch data from MCS
  static String lastStatus = MCS_RecieveData();
  String str = MCS_RecieveData();
  //Serial.print("Get ");
  //Serial.println(str);
  if(str == "0" && lastStatus != str){
    relayHandle(OFF);    
  }else if(lastStatus != str) {
    relayHandle(ON);      
  }
  lastStatus = str;
  Serial.print("lastStatus: ");
  Serial.println(lastStatus);
  
  //Upload data to MCS
  MCS_UploadData(light_value);
  
  delay(1000);
}
